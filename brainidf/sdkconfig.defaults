## brainidf/sdkconfig.defaults
```kconfig
# Rust often needs a bit of an extra main task stack size compared to C (the default is 3K)
CONFIG_ESP_MAIN_TASK_STACK_SIZE=20000

# Use this to set FreeRTOS kernel tick frequency to 1000 Hz (100 Hz by default).
# This allows to use 1 ms granularity for thread sleeps (10 ms by default).
#CONFIG_FREERTOS_HZ=1000

# Workaround for https://github.com/espressif/esp-idf/issues/7631
#CONFIG_MBEDTLS_CERTIFICATE_BUNDLE=n
#CONFIG_MBEDTLS_CERTIFICATE_BUNDLE_DEFAULT_FULL=n


CONFIG_ETH_ENABLED=y
CONFIG_ETH_USE_ESP32_EMAC=y
CONFIG_ETH_PHY_INTERFACE_RMII=y
CONFIG_ETH_RMII_CLK_OUTPUT=y
CONFIG_ETH_RMII_CLK_OUT_GPIO=17
CONFIG_ETH_DMA_BUFFER_SIZE=512
CONFIG_ETH_DMA_RX_BUFFER_NUM=10
CONFIG_ETH_DMA_TX_BUFFER_NUM=10

# For async spi support
# https://github.com/esp-rs/esp-idf-hal/issues/486
CONFIG_SPI_MASTER_ISR_IN_IRAM=n

CONFIG_ESP_WIFI_TASK_CORE_ID=0

# Disable watchdog on Core1, the led DMA task, as petting it does not work for
# some reason...
CONFIG_ESP_TASK_WDT_CHECK_IDLE_TASK_CPU1=n 

# some ideas from chatgpt, but didnt necessarily help in some testing
# CONFIG_ESP_MAIN_TASK_AFFINITY=CPU0
# 
# 
# CONFIG_RMT_TX_ISR_CACHE_SAFE=y      # ⇢ “Allow RMT TX ISR to execute when cache is disabled”  [oai_citation:1‡docs.espressif.com](https://docs.espressif.com/projects/esp-idf/en/stable/esp32/api-reference/kconfig-reference.html?utm_source=chatgpt.com)
# 
# CONFIG_PM_ENABLE=n          # keep APB & CPU clocks fixed while LEDs stream
# CONFIG_BT_ENABLED=n
# CONFIG_BLUEDROID_ENABLED=n
# CONFIG_ESP_WIFI_ENABLED=n 
# 
# 
# # --- RMT jitter hardening ---------------------------------
# CONFIG_RMT_TX_ISR_HANDLER_IN_IRAM=y
# CONFIG_RMT_ENCODER_FUNC_IN_IRAM=y
# CONFIG_RMT_TX_ISR_CACHE_SAFE=y
```
